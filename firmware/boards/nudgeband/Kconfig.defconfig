## firmware/boards/nudgeband/Kconfig.defconfig
```kconfig
# SPDX-License-Identifier: MIT

if BOARD_NUDGEBAND_NRF54L10_CPUAPP

config HW_STACK_PROTECTION
	default ARCH_HAS_STACK_PROTECTION

config ROM_START_OFFSET
	default 0x800 if BOOTLOADER_MCUBOOT

endif
```

## firmware/boards/nudgeband/board.yml
```yaml
board:
  name: nudgeband
  full_name: NudgeBand wristband (rev C)
  socs:
    - name: nrf54l10
```
